## components/hivekit/Kconfig
```kconfig
menu "HiveKit Configuration"

    config HIVEKIT_BUTTON_ENABLED
        bool "Enable BOOT button support"
        default y
        help
            Enable button handling via espressif/button component.
            Disable if you want to handle the button yourself.

    config HIVEKIT_BUTTON_GPIO
        int "Button GPIO number"
        default 9
        depends on HIVEKIT_BUTTON_ENABLED
        help
            GPIO for the pairing/reset button.
            On XIAO ESP32-C6 this is GPIO9 (BOOT button).
            Active LOW; internal pull-up is enabled.

    config HIVEKIT_BUTTON_LONG_PRESS_TIME_MS
        int "Long press threshold (ms) for pairing"
        default 3000
        depends on HIVEKIT_BUTTON_ENABLED
        help
            Hold duration in milliseconds to trigger network steering (pairing mode).

    config HIVEKIT_BUTTON_SHORT_PRESS_TIME_MS
        int "Short press threshold (ms)"
        default 100
        depends on HIVEKIT_BUTTON_ENABLED
        help
            Minimum hold duration in milliseconds to register a single press.

    config HIVEKIT_LED_ENABLED
        bool "Enable LED support"
        default y
        help
            Enable LED state machine via espressif/led_indicator component.
            Disable if your board has no LED or you handle it yourself.

    config HIVEKIT_LED_GPIO
        int "LED GPIO number"
        default 15
        depends on HIVEKIT_LED_ENABLED
        help
            GPIO connected to the status LED.
            On XIAO ESP32-C6 the onboard LED is on GPIO15 (active HIGH).
            Check your board's schematic — some variants use different pins.

    config HIVEKIT_LED_ACTIVE_HIGH
        bool "LED active HIGH"
        default y
        depends on HIVEKIT_LED_ENABLED
        help
            Set to y if LED turns on when GPIO is HIGH.
            Set to n if LED turns on when GPIO is LOW (active LOW).


    config HIVEKIT_ZIGBEE_PRIMARY_CHANNEL_MASK
        hex "Zigbee primary channel scan mask"
        default 0x07FFF800
        help
            32-bit bitmask of 802.15.4 channels to scan during network steering.
            Default 0x07FFF800 = all standard Zigbee channels (11-26), matching
            the florianL21/zigbee-co2-sensor reference framework. Pin to a
            single channel for faster cold-boot if your coordinator is fixed
            (e.g. channel 11 only = (1 << 11) = 0x00000800).

    config HIVEKIT_ZIGBEE_KEEP_ALIVE_MS
        int "Zigbee end-device keep-alive interval (ms)"
        default 180000
        range 30000 600000
        help
            How often (in milliseconds) the end device polls its parent router
            to keep the link alive. The default 180 000 ms (3 min) matches the
            florianL21/zigbee-co2-sensor reference and typical coordinator
            expectations. A very short value (e.g. the old default of 4 000 ms)
            causes aggressive re-joining on transient link blips because the
            stack declares the parent dead before it recovers from congestion.
            Combined with a matching long-poll interval set post-join, 180 000 ms
            prevents unnecessary router-hopping.

    config HIVEKIT_BOARD_XIAO_C6_ANTENNA
        bool "Select on-PCB antenna on XIAO ESP32-C6 boot"
        default y
        help
            Drives GPIO3 LOW (RF amplifier enable) and GPIO14 LOW
            (antenna select = PCB chip antenna) early in app_main(),
            before NVS or the Zigbee stack are initialised.

            The XIAO ESP32-C6 RF switch is not driven at power-on, which
            leaves the antenna selection floating and degrades RF performance
            by approximately 20-30 dB.  This option fixes that.

            Disable only if you are using an external U.FL antenna — in that
            case you must drive GPIO14 HIGH yourself.

endmenu
```

## sensors/bme280-c6/Kconfig.projbuild
```kconfig
# menu "HiveKit BME280 Sensor Configuration"
# This file provides sensor-specific Kconfig options for bme280-c6.
# The shared hivekit component's Kconfig is at components/hivekit/Kconfig.

menu "HiveKit BME280 Sensor"

    config HIVEKIT_BME280_SDA_GPIO
        int "I²C SDA GPIO"
        default 22
        help
            GPIO number for I²C SDA line.
            On XIAO ESP32-C6 this is GPIO22 (shared with SCD40 pinout).

    config HIVEKIT_BME280_SCL_GPIO
        int "I²C SCL GPIO"
        default 23
        help
            GPIO number for I²C SCL line.
            On XIAO ESP32-C6 this is GPIO23 (shared with SCD40 pinout).

    config HIVEKIT_BME280_I2C_ADDR
        hex "BME280 I²C address"
        default 0x76
        help
            7-bit I²C address of the BME280 sensor.
            0x76 when SDO pin tied to GND (most breakout boards default).
            0x77 when SDO pin tied to VDDIO (3.3V).
            Reference: BME280 datasheet §6.2, Table 13.

    config HIVEKIT_BME280_MEASUREMENT_INTERVAL_MS
        int "Sensor measurement interval (ms)"
        default 30000
        help
            How often to trigger a forced-mode measurement and report to Zigbee.
            Default 30000 = 30 seconds (matches SCD40 debug interval).
            Minimum recommended: 5000 (5s). Indoor use: 30000-300000.
            Bosch recommendation for weather/indoor: one measurement per minute.

endmenu
```

## sensors/bme280-c6/sdkconfig.defaults
```kconfig
# Zigbee end-device defaults for HiveKit BME280
# Apply with: idf.py build (auto-merged with sdkconfig)

# Target
CONFIG_IDF_TARGET="esp32c6"

# Flash size — XIAO ESP32-C6 has 4MB
CONFIG_ESPTOOLPY_FLASHSIZE_4MB=y
CONFIG_ESPTOOLPY_FLASHSIZE="4MB"

# Custom partition table (defines zb_storage / zb_fct / ota_0 / ota_1)
CONFIG_PARTITION_TABLE_CUSTOM=y
CONFIG_PARTITION_TABLE_CUSTOM_FILENAME="partitions.csv"
CONFIG_PARTITION_TABLE_FILENAME="partitions.csv"

# Zigbee role: End Device
CONFIG_ZB_ENABLED=y
CONFIG_ZB_ED_ROLE=y
CONFIG_ZB_ZCZR_ROLE=n

# Zigbee NVS partitions (must match partitions.csv)
CONFIG_ZB_NVRAM_PARTITION="zb_storage"
CONFIG_ZB_NVRAM_FCT_PARTITION="zb_fct"

# Power management — DISABLED (matching SCD40 baseline for stability)
# Re-enable once joined-state stability is proven on real hardware.
# CONFIG_PM_ENABLE=y
# CONFIG_FREERTOS_USE_TICKLESS_IDLE=y

# Log level: INFO
CONFIG_LOG_DEFAULT_LEVEL_INFO=y

# HiveKit Kconfig defaults
CONFIG_HIVEKIT_BUTTON_ENABLED=y
CONFIG_HIVEKIT_BUTTON_GPIO=9
CONFIG_HIVEKIT_BUTTON_LONG_PRESS_TIME_MS=3000
CONFIG_HIVEKIT_BUTTON_SHORT_PRESS_TIME_MS=100
CONFIG_HIVEKIT_LED_ENABLED=y
CONFIG_HIVEKIT_LED_GPIO=15
CONFIG_HIVEKIT_LED_ACTIVE_HIGH=y

# BME280 I2C — reuse same bus as SCD40 (SDA=22, SCL=23)
CONFIG_HIVEKIT_BME280_SDA_GPIO=22
CONFIG_HIVEKIT_BME280_SCL_GPIO=23
# BME280 default address: SDO pin tied to GND → 0x76
# If SDO tied to VDDIO (3.3V) → 0x77
CONFIG_HIVEKIT_BME280_I2C_ADDR=0x76

# FreeRTOS
CONFIG_FREERTOS_HZ=1000

# Disable Zigbee Green Power — frees scan budget, not used by Z2M
CONFIG_ZB_ENABLE_ZGP=n
```

## sensors/pir-c6/Kconfig.projbuild
```kconfig
# menu "HiveKit PIR Sensor Configuration"
# This file provides sensor-specific Kconfig options for pir-c6.
# The shared hivekit component's Kconfig is at components/hivekit/Kconfig.

menu "HiveKit PIR Sensor"

    config HIVEKIT_PIR_GPIO
        int "PIR output GPIO"
        default 2
        help
            GPIO number connected to the PIR module's signal (OUT) pin.
            Recommended: GPIO2 or GPIO4 on XIAO ESP32-C6.
            GPIO2 is used by default (free from I²C, SPI, UART, JTAG conflicts
            on XIAO ESP32-C6 with standard HiveKit pinout).
            Reference: Seeed Studio XIAO ESP32-C6 pinout diagram.

    config HIVEKIT_PIR_ACTIVE_HIGH
        bool "PIR output is active-high"
        default y
        help
            Most PIR modules (AM312, HC-SR501) drive their OUT pin HIGH on motion
            and LOW when idle. Set this to 'n' if your module uses active-low logic.

    config HIVEKIT_PIR_DEBOUNCE_MS
        int "Debounce interval (ms)"
        default 250
        help
            Minimum time between occupancy state change reports.
            PIR modules can chatter (toggle rapidly) around the detection threshold.
            250 ms prevents burst-reporting while still capturing quick re-triggers.
            Valid range: 0–5000.

    config HIVEKIT_PIR_KEEPALIVE_INTERVAL_S
        int "Keepalive report interval (seconds)"
        default 300
        help
            How often to send a periodic occupancy report even if the state has
            not changed. This acts as a heartbeat so Z2M does not mark the device
            as unavailable.
            Default 300 = 5 minutes. ZCL reporting max-interval will be set to
            this value.

endmenu
```

## sensors/pir-c6/sdkconfig.defaults
```kconfig
# Zigbee end-device defaults for HiveKit PIR
# Apply with: idf.py build (auto-merged with sdkconfig)

# Target
CONFIG_IDF_TARGET="esp32c6"

# Flash size — XIAO ESP32-C6 has 4MB
CONFIG_ESPTOOLPY_FLASHSIZE_4MB=y
CONFIG_ESPTOOLPY_FLASHSIZE="4MB"

# Custom partition table (defines zb_storage / zb_fct / ota_0 / ota_1)
CONFIG_PARTITION_TABLE_CUSTOM=y
CONFIG_PARTITION_TABLE_CUSTOM_FILENAME="partitions.csv"
CONFIG_PARTITION_TABLE_FILENAME="partitions.csv"

# Zigbee role: End Device
CONFIG_ZB_ENABLED=y
CONFIG_ZB_ED_ROLE=y
CONFIG_ZB_ZCZR_ROLE=n

# Zigbee NVS partitions (must match partitions.csv)
CONFIG_ZB_NVRAM_PARTITION="zb_storage"
CONFIG_ZB_NVRAM_FCT_PARTITION="zb_fct"

# Power management — DISABLED intentionally.
# PIR is an always-on sensor: it must stay awake to detect motion events.
# Deep sleep would cause missed detections. See README.md for details.
# CONFIG_PM_ENABLE=y
# CONFIG_FREERTOS_USE_TICKLESS_IDLE=y

# Log level: INFO
CONFIG_LOG_DEFAULT_LEVEL_INFO=y

# HiveKit Kconfig defaults
CONFIG_HIVEKIT_BUTTON_ENABLED=y
CONFIG_HIVEKIT_BUTTON_GPIO=9
CONFIG_HIVEKIT_BUTTON_LONG_PRESS_TIME_MS=3000
CONFIG_HIVEKIT_BUTTON_SHORT_PRESS_TIME_MS=100
CONFIG_HIVEKIT_LED_ENABLED=y
CONFIG_HIVEKIT_LED_GPIO=15
CONFIG_HIVEKIT_LED_ACTIVE_HIGH=y

# PIR GPIO defaults
CONFIG_HIVEKIT_PIR_GPIO=2
CONFIG_HIVEKIT_PIR_ACTIVE_HIGH=y
CONFIG_HIVEKIT_PIR_DEBOUNCE_MS=250
CONFIG_HIVEKIT_PIR_KEEPALIVE_INTERVAL_S=300

# FreeRTOS
CONFIG_FREERTOS_HZ=1000

# Disable Zigbee Green Power — frees scan budget, not used by Z2M
CONFIG_ZB_ENABLE_ZGP=n
```

## sensors/scd40-c6/Kconfig.projbuild
```kconfig
# menu "HiveKit SCD40 Sensor Configuration"
# This file provides sensor-specific Kconfig options for scd40-c6.
# The shared hivekit component's Kconfig is at components/hivekit/Kconfig.

menu "HiveKit SCD40 Sensor"

    config HIVEKIT_SCD40_SDA_GPIO
        int "I²C SDA GPIO"
        default 22
        help
            GPIO number for I²C SDA line.
            On XIAO ESP32-C6 with Adafruit SCD-41 breakout this is GPIO22.

    config HIVEKIT_SCD40_SCL_GPIO
        int "I²C SCL GPIO"
        default 23
        help
            GPIO number for I²C SCL line.
            On XIAO ESP32-C6 with Adafruit SCD-41 breakout this is GPIO23.

    config HIVEKIT_SCD40_MEASUREMENT_INTERVAL_MS
        int "Sensor measurement interval (ms)"
        default 300000
        help
            How often to push sensor readings to Zigbee (milliseconds).
            Default 300000 = 5 minutes. The SCD40 always measures every 5s
            internally; this controls how often we read and report.
            Minimum recommended: 30000 (30s).

endmenu
```

## sensors/scd40-c6/sdkconfig.defaults
```kconfig
# Zigbee end-device defaults for HiveKit SCD40
# Apply with: idf.py build (auto-merged with sdkconfig)

# Target
CONFIG_IDF_TARGET="esp32c6"

# Flash size — XIAO ESP32-C6 has 4MB
CONFIG_ESPTOOLPY_FLASHSIZE_4MB=y
CONFIG_ESPTOOLPY_FLASHSIZE="4MB"

# Custom partition table (defines zb_storage / zb_fct / ota_0 / ota_1)
CONFIG_PARTITION_TABLE_CUSTOM=y
CONFIG_PARTITION_TABLE_CUSTOM_FILENAME="partitions.csv"
CONFIG_PARTITION_TABLE_FILENAME="partitions.csv"

# Zigbee role: End Device
CONFIG_ZB_ENABLED=y
CONFIG_ZB_ED_ROLE=y
CONFIG_ZB_ZCZR_ROLE=n

# Zigbee NVS partitions (must match partitions.csv)
CONFIG_ZB_NVRAM_PARTITION="zb_storage"
CONFIG_ZB_NVRAM_FCT_PARTITION="zb_fct"

# Power management — DISABLED for Phase 1 first-join.
# v2 SDK has no equivalent of esp_zb_sleep_enable(); tickless idle fires during
# the 16-channel scan and causes missed beacons. Re-enable once joined and
# once we have proper v2 PM coordination.
# CONFIG_PM_ENABLE=y
# CONFIG_FREERTOS_USE_TICKLESS_IDLE=y
# CONFIG_PM_POWER_DOWN_CPU_IN_LIGHT_SLEEP=y

# Log level: INFO in production, DEBUG for development
CONFIG_LOG_DEFAULT_LEVEL_INFO=y
# CONFIG_LOG_DEFAULT_LEVEL_DEBUG=y

# HiveKit Kconfig defaults (can be overridden in sdkconfig)
CONFIG_HIVEKIT_BUTTON_ENABLED=y
CONFIG_HIVEKIT_BUTTON_GPIO=9
CONFIG_HIVEKIT_BUTTON_LONG_PRESS_TIME_MS=3000
CONFIG_HIVEKIT_BUTTON_SHORT_PRESS_TIME_MS=100
CONFIG_HIVEKIT_LED_ENABLED=y
CONFIG_HIVEKIT_LED_GPIO=15
CONFIG_HIVEKIT_LED_ACTIVE_HIGH=y
CONFIG_HIVEKIT_SCD40_SDA_GPIO=22
CONFIG_HIVEKIT_SCD40_SCL_GPIO=23

# FreeRTOS
CONFIG_FREERTOS_HZ=1000

# Sleep mode intentionally disabled for v0.3.3-beta baseline.
# Re-add CONFIG_IEEE802154_SLEEP_ENABLE + CONFIG_PM_ENABLE + esp_zb_sleep_enable()
# together in a future change once joined-state stability is proven.

# Disable Zigbee Green Power — frees scan budget, not used by Z2M anyway.
CONFIG_ZB_ENABLE_ZGP=n
```

## sensors/sht40-c6/Kconfig.projbuild
```kconfig
# menu "HiveKit SHT40 Sensor Configuration"
# This file provides sensor-specific Kconfig options for sht40-c6.
# The shared hivekit component's Kconfig is at components/hivekit/Kconfig.

menu "HiveKit SHT40 Sensor"

    config HIVEKIT_SHT40_SDA_GPIO
        int "I²C SDA GPIO"
        default 22
        help
            GPIO number for I²C SDA line.
            On XIAO ESP32-C6 this is GPIO22 (shared with SCD40/BME280 pinout).

    config HIVEKIT_SHT40_SCL_GPIO
        int "I²C SCL GPIO"
        default 23
        help
            GPIO number for I²C SCL line.
            On XIAO ESP32-C6 this is GPIO23 (shared with SCD40/BME280 pinout).

    config HIVEKIT_SHT40_I2C_ADDR
        hex "SHT40 I²C address"
        default 0x44
        help
            7-bit I²C address of the SHT40 sensor.
            0x44 — SHT40-AD1B (default for most breakout boards).
            0x45 — SHT40-BD1B alternate variant.
            0x46 — SHT40-BD1B second alternate variant.
            Reference: SHT40 datasheet §2.1.

    config HIVEKIT_SHT40_MEASUREMENT_INTERVAL_MS
        int "Sensor measurement interval (ms)"
        default 30000
        help
            How often to trigger a high-precision measurement and report to Zigbee.
            Default 30000 = 30 seconds (matches SCD40/BME280 interval).
            Minimum recommended: 5000 (5s). Indoor use: 30000-300000.
            The SHT40 has no minimum interval restriction at high precision.

endmenu
```
